/* source key position labels */
#include "zmk-helpers/key-labels/totem.h"

#define X_LB  &lt SHORTCUTS ESC
#define X_RB  &lt SHORTCUTS MINUS

/* activate bluetooth */
#define CONFIG_WIRELESS 1
#define TOTEM 1

/* source the main keymap */
#include "base.keymap"
